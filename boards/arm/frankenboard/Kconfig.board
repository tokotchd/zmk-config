## boards/arm/frankenboard/Kconfig.board
```kconfig
config BOARD_FRANKENBOARD
    bool "frankenboard"
    depends on SOC_NRF52840_QIAA
```

## boards/shields/test_shield/Kconfig.defconfig
```kconfig
if SHIELD_TEST_SHIELD

config ZMK_KEYBOARD_NAME
    default "test_shield"

endif # SHIELD_TEST_SHIELD
```
